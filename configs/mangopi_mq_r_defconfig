## configs/mangopi_mq_r_defconfig
```kconfig
CONFIG_ARM=y
CONFIG_ARCH_SUNXI=y
CONFIG_DEFAULT_DEVICE_TREE="sun8i-t113s-mangopi-mq-r-t113"
CONFIG_SPL=y
CONFIG_MACH_SUN8I_R528=y
CONFIG_DRAM_CLK=792
CONFIG_DRAM_ZQ=8092667
CONFIG_SUNXI_MINIMUM_DRAM_MB=128
CONFIG_UART2_PORT_E=y
CONFIG_SPL_SPI_SUNXI=y
# CONFIG_SYS_MALLOC_CLEAR_ON_INIT is not set
CONFIG_SPL_LOAD_FIT=y
CONFIG_SPL_LEGACY_IMAGE_FORMAT=y
CONFIG_SPL_FIT_IMAGE_TINY=y
CONFIG_SPL_SPINAND_SUPPORT=y
CONFIG_SPL_SPINAND_PAGE_SIZE=0x800
CONFIG_SPL_SPINAND_BLOCK_SIZE=0x20000
CONFIG_SPL_UBI=y
CONFIG_SPL_UBI_MAX_VOL_LEBS=2048
CONFIG_SPL_UBI_MAX_PEB_SIZE=131072
CONFIG_SPL_UBI_MAX_PEBS=2048
CONFIG_SPL_UBI_PEB_OFFSET=4
CONFIG_SPL_UBI_VID_OFFSET=2048
CONFIG_SPL_UBI_LEB_START=4096
CONFIG_SPL_UBI_INFO_ADDR=0x41000000
CONFIG_SPL_UBI_VOL_IDS=256
CONFIG_SPL_UBI_LOAD_MONITOR_ID=0
CONFIG_DRAM_SUNXI_ODT_EN=0
CONFIG_DRAM_SUNXI_TPR0=0x004a2195
CONFIG_DRAM_SUNXI_TPR11=0x340000
CONFIG_DRAM_SUNXI_TPR12=0x46
CONFIG_DRAM_SUNXI_TPR13=0x34000100
CONFIG_CONS_INDEX=2
```

## configs/tronlong_tlt113_minevm_defconfig
```kconfig
CONFIG_ARM=y
CONFIG_ARCH_SUNXI=y
CONFIG_SYS_BOARD="tlt113-minievm"
CONFIG_DEFAULT_DEVICE_TREE="sun8i-t113i-tronlong-tlt113-minievm"
CONFIG_MACH_SUN8I_R528=y
CONFIG_OF_LIVE=y
# CONFIG_ENV_IS_IN_FAT is not set
# CONFIG_ENV_IS_IN_SPI_FLASH is not set
CONFIG_ENV_IS_IN_UBI=y
CONFIG_ENV_UBI_PART="env"
CONFIG_ENV_UBI_VOLUME="env"
CONFIG_ENV_UBI_VID_OFFSET=2048
CONFIG_SPL=y
CONFIG_SPL_DM=y
CONFIG_SPL_OF_CONTROL=y
CONFIG_SPL_SPINAND_SUPPORT=y
CONFIG_SPL_SPINAND_PAGE_SIZE=0x800
CONFIG_SPL_SPINAND_BLOCK_SIZE=0x20000
CONFIG_SPL_SPI_SUNXI=y
CONFIG_SUNXI_MINIMUM_DRAM_MB=256
# CONFIG_SYS_MALLOC_CLEAR_ON_INIT is not set
CONFIG_DRAM_CLK=792
CONFIG_DRAM_ZQ=8092667
CONFIG_DRAM_SUNXI_ODT_EN=1
CONFIG_DRAM_SUNXI_TPR0=0x004a2195
CONFIG_DRAM_SUNXI_TPR11=0x770000
CONFIG_DRAM_SUNXI_TPR12=0x2
CONFIG_DRAM_SUNXI_TPR13=0x34050100
CONFIG_CONS_INDEX=3
CONFIG_UART2_PORT_G=y
CONFIG_MTD=y
CONFIG_DM_MTD=y
CONFIG_MTD_SPI_NAND=y
CONFIG_SPI=y
CONFIG_CMD_MTD=y
CONFIG_CMD_UBI=y
```

## configs/tukvm_pcie_defconfig
```kconfig
CONFIG_ARM=y
CONFIG_ARCH_SUNXI=y
CONFIG_DEFAULT_DEVICE_TREE="sun8i-t113i-tukvm-pcie"
CONFIG_SPL=y
CONFIG_MACH_SUN8I_R528=y
CONFIG_DRAM_CLK=792
CONFIG_DRAM_ZQ=8092667
CONFIG_UART0_PORT_G=y
CONFIG_SPL_SPI_SUNXI=y
# CONFIG_SYS_MALLOC_CLEAR_ON_INIT is not set
CONFIG_CMD_MTD=y
CONFIG_CMD_UBI=y
CONFIG_SPL_OF_CONTROL=y
CONFIG_OF_LIVE=y
# CONFIG_ENV_IS_IN_SPI_FLASH is not set
CONFIG_SPL_DM=y
CONFIG_MTD=y
CONFIG_DM_MTD=y
CONFIG_UBI_SILENCE_MSG=y
CONFIG_DRAM_SUNXI_ODT_EN=1
CONFIG_DRAM_SUNXI_TPR0=0x004a2195
CONFIG_DRAM_SUNXI_TPR11=0x770000
CONFIG_DRAM_SUNXI_TPR12=0x2
CONFIG_DRAM_SUNXI_TPR13=0x34050100
CONFIG_SPI=y
CONFIG_UBIFS_SILENCE_MSG=y
```

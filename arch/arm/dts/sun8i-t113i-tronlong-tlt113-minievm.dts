// SPDX-License-Identifier: (GPL-2.0+ OR MIT)
// Copyright (C) 2022 Arm Ltd.

#include <dt-bindings/interrupt-controller/irq.h>

/dts-v1/;

#include "sun8i-t113i.dtsi"
#include "sunxi-t113i-tronlong-tlt113.dtsi"

/ {
	model = "Tronlong TLT113-MiniEVM";
	compatible = "tronlong,tlt113-minievm", "allwinner,sun8i-t113i";
};

&cpu0 {
	cpu-supply = <&reg_vcc_core>;
};

&cpu1 {
	cpu-supply = <&reg_vcc_core>;
};

&mmc0 {
	pinctrl-0 = <&mmc0_pins>;
	pinctrl-names = "default";
	vmmc-supply = <&reg_3v3>;
	cd-gpios = <&pio 5 6 GPIO_ACTIVE_LOW>;
	disable-wp;
	bus-width = <4>;
	status = "okay";
};

